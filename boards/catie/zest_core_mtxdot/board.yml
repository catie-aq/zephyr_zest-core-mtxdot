## boards/catie/zest_core_mtxdot/board.yml
```yaml
board:
  name: zest_core_mtxdot
  full_name: Zest_Core_MXTDOT
  vendor: catie
  socs:
    - name: stm32l151xc
  revision:
    format: "major.minor.patch"
    default: "1.0.0"
    exact: true
    revisions:
      - name: "1.0.0"
```
